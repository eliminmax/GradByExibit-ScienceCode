#include <Wire.h>
#include <SPI.h>
#include <stdlib.h>
#include <Adafruit_PN532.h>
// If using the breakout or shield with I2C, define just the pins connected
// to the IRQ and reset lines.  Use the values below (2, 3) for the shield!
#define PN532_IRQ   (2)
#define PN532_RESET (3)  // Not connected by default on the NFC Shield

int8_t blocksToWrite[32] = {4, 5, 6, 8, 9, 10, 12, 13, 14, 16, 17, 18, 20, 21, 22, 24, 25, 26, 28, 29, 30, 32, 33, 34, 36, 37, 38, 40, 41, 42, 44, 45};//Sectors to write to
uint8_t cardData[32][16] =
{ {0xff, 0x2d, 0x26, 0x2b, 0xfa, 0x10, 0x99, 0x0c, 0x14, 0x2c, 0x5a, 0x58, 0x4a, 0xf6, 0xd6, 0x8b},//Data to write (512 bytes of random noise from random.org)
  {0x3b, 0x88, 0x3e, 0x0d, 0x30, 0x6d, 0xdd, 0x13, 0x18, 0x5b, 0x6b, 0xe9, 0x26, 0xfa, 0xab, 0x01},
  {0x8a, 0x24, 0x12, 0x4c, 0xae, 0x67, 0xdb, 0xb2, 0xf4, 0x51, 0xfc, 0xfe, 0xad, 0x91, 0x71, 0xec},
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  {0x3f, 0x55, 0xc7, 0x55, 0xcd, 0x83, 0xe5, 0xca, 0xaf, 0x19, 0x8c, 0x4d, 0x03, 0x69, 0x4e, 0x2e}
};
// Use this line for a breakout or shield with an I2C connection:
Adafruit_PN532 nfc(PN532_IRQ, PN532_RESET);

void setup(void) {
  Serial.begin(115200);
  Serial.println("Hello!");

  nfc.begin();

  uint32_t versiondata = nfc.getFirmwareVersion();
  if (! versiondata) {
    Serial.print("Didn't find PN53x board");
    while (1); // halt
  }
  // Got ok data, print it out!
  Serial.print("Found chip PN5"); Serial.println((versiondata >> 24) & 0xFF, DEC);
  Serial.print("Firmware ver. "); Serial.print((versiondata >> 16) & 0xFF, DEC);
  Serial.print('.'); Serial.println((versiondata >> 8) & 0xFF, DEC);

  // configure board to read RFID tags
  nfc.SAMConfig();

  Serial.println("Waiting for an ISO14443A Card ...");
}


void loop(void) {
  delay(2500);
  uint8_t success;
  uint8_t uid[] = { 0, 0, 0, 0, 0, 0, 0 };  // Buffer to store the returned UID
  uint8_t uidLength;                        // Length of the UID (4 or 7 bytes depending on ISO14443A card type)
  // Wait for an ISO14443A type cards (Mifare, etc.).  When one is found
  // 'uid' will be populated with the UID, and uidLength will indicate
  success = nfc.readPassiveTargetID(PN532_MIFARE_ISO14443A, uid, &uidLength);
  if (success) {
    // Display some basic information about the card
    Serial.println("Found an ISO14443A card");
    Serial.print("  UID Length: "); Serial.print(uidLength, DEC); Serial.println(" bytes");
    Serial.print("  UID Value: ");
    nfc.PrintHex(uid, uidLength);
    Serial.println("");
    if (uidLength == 4)
    {
      // We probably have a Mifare Classic card
      for (int dataBlock = 0, currentSector = 0; dataBlock < 32; dataBlock ++) {
        uint8_t keya[6] = {0xFF, 0xFF, 0xFF, 0xFF, 0xFF, 0xFF};
        currentSector++;
        Serial.println("Trying to authenticate block with default KEYA value");
        success = nfc.mifareclassic_AuthenticateBlock(uid, uidLength, blocksToWrite[dataBlock], 0, keya);
        if (!success) {
          success = nfc.mifareclassic_AuthenticateBlock(uid, uidLength, blocksToWrite[dataBlock], 1, keya);
        }
        if (success)
        {
          Serial.println("Sector has been authenticated");
        } else {
          Serial.println("Sector failed to authenticate, ensure that KEYA is 0xFF, 0xFF, 0xFF, 0xFF, 0xFF, 0xFF.");
          while (1) {};

        }
        uint8_t blockBytes[16];
        memcpy(blockBytes, cardData[dataBlock], sizeof cardData[dataBlock]  );
        success = nfc.mifareclassic_WriteDataBlock (blocksToWrite[dataBlock], blockBytes );

        if (success)
        {
          Serial.print("Wrote to Block "); Serial.println(blocksToWrite[dataBlock]);
          Serial.println("");
        }
        else
        {
          Serial.println("Unable to write to the requested block.  Ensure KEYA is 0xFF, 0xFF, 0xFF, 0xFF, 0xFF, 0xFF.");
        }
      }
    }
  }
  Serial.println("\n\nSend a character to run the writer again!");
  Serial.flush();
  while (!Serial.available());
  while (Serial.available()) {
    Serial.read();
  }
  Serial.flush();
}
